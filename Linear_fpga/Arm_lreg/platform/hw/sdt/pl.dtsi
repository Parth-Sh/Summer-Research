/ {
	amba_pl: amba_pl {
		ranges;
		compatible = "simple-bus";
		#address-cells = <1>;
		#size-cells = <1>;
		firmware-name = "design_1_wrapper.bit.bin";
		clocking0: clocking0 {
			compatible = "xlnx,fclk";
			assigned-clocks = <&clkc 15>;
			assigned-clock-rates = <50000000>;
			#clock-cells = <0>;
			clock-output-names = "fabric_clk";
			clocks = <&clkc 15>;
		};
		linear_model_0: linear_model@40000000 {
			compatible = "xlnx,linear-model-1.0";
			xlnx,ii = <3>;
			xlnx,machine = <64>;
			xlnx,ip-name = "linear_model";
			xlnx,s-axi-hls-linear-periph-bus-addr-width = <6>;
			reg = <0x40000000 0x10000>;
			clocks = <&clkc 15>;
			xlnx,clk-period = <10>;
			xlnx,edk-iptype = "PERIPHERAL";
			status = "okay";
			xlnx,s-axi-hls-linear-periph-bus-data-width = <32>;
			clock-names = "ap_clk";
			xlnx,combinational = <0>;
			xlnx,latency = <2>;
			xlnx,name = "linear_model_0";
		};
	};
};
